//Including the necissary libraries
#include <Arduino.h>
#include <stdint.h>
#include "SCMD.h"
#include "SCMD_config.h"
#include "Wire.h"
#include <Adafruit_GFX.h>
#include <Adafruit_SSD1306.h>
#include <SparkFun_Qwiic_Button.h>
#include "SparkFun_Qwiic_MP3_Trigger_Arduino_Library.h"

#define OLED_RESET -1

Adafruit_SSD1306 display(128, 64, &Wire, OLED_RESET);
MP3TRIGGER mp3;
SCMD myMotorDriver;
QwiicButton button;

int brightness = 100; //Button brightness
bool startCheck = false; //Checking if the starting button was pressed



const unsigned char myBitmap [] PROGMEM = {
 0xff, 0xff, 0xff, 0xff, 0xff, 0xff, 0xff, 0xff, 0xff, 0xff, 0xff, 0xff, 0xff, 0xff, 0xff, 0xff, 
 0xff, 0xff, 0xff, 0xff, 0xff, 0xff, 0xff, 0xff, 0xff, 0xff, 0xff, 0xff, 0xff, 0xff, 0xff, 0xff, 
  0xff, 0xff, 0xff, 0xff, 0xff, 0xff, 0xff, 0xff, 0xff, 0xff, 0xff, 0xff, 0xff, 0xff, 0xff, 0xff, 
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  0xff, 0xff, 0xff, 0xff, 0xff, 0xff, 0xff, 0xff, 0xff, 0xff, 0xff, 0xff, 0xff, 0xff, 0xff, 0xff, 
  0xff, 0xff, 0xff, 0xff, 0xff, 0xff, 0xff, 0xff, 0xff, 0xff, 0xff, 0xff, 0xff, 0xff, 0xff, 0xff+.
};


void setup() {
  Serial.begin(9600);
  display.begin(SSD1306_SWITCHCAPVCC, 0x3D);          //Loading display
  display.clearDisplay();                             //for Clearing the display
  display.drawBitmap(0, 0, myBitmap, 128, 64, WHITE); //Drawing the bitmap
  display.display();
  myMotorDriver.settings.commInterface = I2C_MODE;    //Setting motor driver at I2C
  myMotorDriver.settings.I2CAddress = 0x5D;           //I2C address of motor driver
  Wire.begin(); //Join I2C bus

  if (mp3.begin() == false) {
    Serial.println("Check MP3 I2C");     //Checking if there is a problem with MP3 I2C address
    while (1);
  }

  mp3.setVolume(20); //Volume of the MP3 played


  if (button.begin() == false) {
    Serial.println("Button not found"); //Checking if there is a problem with button I2C address
    while (1);
  }
  Serial.println("Button found.");

  button.LEDoff();                      //Button LED turned off at start


  //  while ( myMotorDriver.busy() ); //Waiting for serial command.
  //  myMotorDriver.enable();
  while ( myMotorDriver.busy() );
  myMotorDriver.inversionMode(0, 0); //Inverting the motors
  while ( myMotorDriver.busy() );
  myMotorDriver.inversionMode(1, 0);

}


#define motor_left 1      //Defining left and right motors
#define motor_right 0
void loop() {

  if (button.isPressed() == true) {
    button.LEDon(brightness);
    startCheck = true;
  }

  if (startCheck == true) {
    delay(1000);                                    //Play the dialogue audio
    mp3.playTrack(1);
  }
  startCheck = false;
  myMotorDriver.setDrive(motor_left, 1, 0);          //Stop the motors
  myMotorDriver.setDrive(motor_right, 1, 0);

}
